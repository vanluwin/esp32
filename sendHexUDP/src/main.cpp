#include <WiFi.h>
#include <WiFiUdp.h>
#define SENT_INTERVAL 10

// WiFi network name and password:
const char* networkName = "....";
const char* networkPswd = "....";

// IP address to send UDP data to
const char* udpAddress = ".....";
const int udpPort = 3333;

// Connection state
bool connected = false;

// Tracks the last time a packet was sent
unsigned int lastSend = 0;

// The udp library class
WiFiUDP udp;

// Example data
int i = 0;
static byte WaveFormTable[4][112] = {
    // Sin wave
    {0x80, 0x83, 0x87, 0x8A, 0x8E, 0x91, 0x95, 0x98, 0x9B, 0x9E, 0xA2, 0xA5,
     0xA7, 0xAA, 0xAD, 0xAF, 0xB2, 0xB4, 0xB6, 0xB8, 0xB9, 0xBB, 0xBC, 0xBD,
     0xBE, 0xBF, 0xBF, 0xBF, 0xC0, 0xBF, 0xBF, 0xBF, 0xBE, 0xBD, 0xBC, 0xBB,
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     0x71, 0x75, 0x78, 0x7C},
    // Triangular wave
    {0x80, 0x84, 0x89, 0x8D, 0x92, 0x96, 0x9B, 0x9F, 0xA4, 0xA8, 0xAD, 0xB2,
     0xB6, 0xBB, 0xBF, 0xC4, 0xC8, 0xCD, 0xD1, 0xD6, 0xDB, 0xDF, 0xE4, 0xE8,
     0xED, 0xF1, 0xF6, 0xFA, 0xFF, 0xFA, 0xF6, 0xF1, 0xED, 0xE8, 0xE4, 0xDF,
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     0x6D, 0x72, 0x76, 0x7B},
};


// wifi event handler
void WiFiEvent(WiFiEvent_t event) {
    switch (event) {
        case SYSTEM_EVENT_STA_GOT_IP:
            // When connected set
            Serial.print("WiFi connected! IP address: ");
            Serial.println(WiFi.localIP());
            // initializes the UDP state
            // This initializes the transfer buffer
            udp.begin(WiFi.localIP(), udpPort);
            connected = true;
            break;
        case SYSTEM_EVENT_STA_DISCONNECTED:
            Serial.println("WiFi lost connection");
            connected = false;
            break;
    }
}

void connectToWiFi(const char* ssid, const char* pwd) {
    Serial.println("Connecting to WiFi network: " + String(ssid));

    // delete old config
    WiFi.disconnect(true);
    // register event handler
    WiFi.onEvent(WiFiEvent);

    // Initiate connection
    WiFi.begin(ssid, pwd);

    Serial.println("Waiting for WIFI connection...");
}

void setup() {
    Serial.begin(115200);

    // Connect to the WiFi network
    connectToWiFi(networkName, networkPswd);
}

void loop() {
    i++;
    if (i >= 112) i = 0;

    // Check connection state and time interval
    if (connected && millis() - lastSend >= SENT_INTERVAL) {
        // Send a packet
        udp.beginPacket(udpAddress, udpPort);
        udp.printf(
            "%X %X\n",
            WaveFormTable[0][i],
            WaveFormTable[1][i]
        );
        udp.endPacket();

        lastSend = millis();
    }
}
